## tests/source_header_check/valid/sample.yaml
```yaml
#==============================================================================
# Copyright (c) 2026 KritvaOS
# SPDX-License-Identifier: Apache-2.0
#
# File        : sample.yaml
# Description : Valid YAML configuration fixture
#
# Component   : Test
# Module      : Source Header Checker
# Layer       : Test
#
# Requirements: N/A
# API         : N/A
#
# Author      : KritvaOS
# Created     : 26-09-2026
#==============================================================================

sample: true
```
